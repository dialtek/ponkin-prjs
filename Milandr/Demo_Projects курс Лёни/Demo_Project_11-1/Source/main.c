/******************************************************************************
 * @File: main.c
 * @Author: Milandr, L.
 * @Project: Demo_Project_11-1
 * @Version: 1.0.0
 * @Compiler: ARM Compiler V5.06 (build 750)
 * @Microcontroller: К1986ВЕ92QI
 * @Device: Отладочная плата «МилКиТЭС»
 * @Date: 29.06.2020
 * @Purpose: Основной модуль
 * @Description:
 * В данном проекте реализованы передача и приём данных по интерфейсу UART.
 * Передаваемые данные представляют собой кодировку цифр 0...9; запуск передачи
 * осуществляет по нажатию кнопки. Принимаемые данные записываются в массив
 * и отображаются на дисплей. Ошибки контроля чётности фиксируются в аппаратном
 * прерывании.
 ******************************************************************************/

// Подключение заголовка
#include "main.h"

// Основная функция
int main(void)
{
  // Общая инициализация
  CPU_Init();   // Система тактирования
  TICK_Init();  // Системный таймер
  BTN_Init();   // Кнопки
  LCD_Init();   // ЖК-дисплей

  // Инициализация UART
  UART_Init();

  // Отображение исходного значения счётчика ошибок контроля чётности
  LCD_PrintString("       PE = %u", 5, parity_error);

  // Основной цикл
  while (true) {

    // Блок работы с передачей данных
    if (Wait(&ticks_mark[0], 100) == false) {

      // Обработка кнопки MID
      if (BTN_Handler(BTN_M) != false) {

        // Передача данных
        UART_TransmitEx();
      }
    }

    // Блок работы с приёмом данных
    if (Wait(&ticks_mark[1], 100) == false) {

      // Приём данных
      UART_ReceiveEx();
    }
  }
}

// Пример передачи данных
void UART_TransmitEx(void)
{
  // Передаваемые данные
  static char tx_data = '0';

  // Передача данных
  MDR_UART2->DR = tx_data;

  // Изменение передаваемой цифры
  tx_data++;

  // Зацикливание (цифры 0...9)
  if (tx_data > '9') {
    tx_data = '0';
  }
}

// Пример приёма данных
void UART_ReceiveEx(void)
{
  // Инициализация переменных
  static char rx_data[RX_BUF_SIZE] = {0};  // Принимаемые данные
  static char i = 0;                       // Индекс элемента массива

  // Пока буфер приёмника не пуст...
  while ((MDR_UART2->FR & UART_FR_RXFE) == 0) {

    // Изъятие данных из буфера приёмника
    rx_data[i] = MDR_UART2->DR;

    // Отображение данных на дисплей
    LCD_PrintSymbol(rx_data[i], i, 3);

    // Переход к следующему элементу
    i = (i + 1) % RX_BUF_SIZE;

    // Отображение значения счётчика ошибок контроля чётности
    LCD_PrintString("       PE = %u", 5, parity_error);
  }
}
