/******************************************************************************
 * @File: main.c
 * @Author: Milandr, L.
 * @Project: Demo_Project_8-2
 * @Version: 1.0.0
 * @Compiler: ARM Compiler V5.06 (build 750)
 * @Microcontroller: К1986ВЕ92QI
 * @Device: Отладочная плата «МилКиТЭС»
 * @Date: 02.04.2020
 * @Purpose: Основной модуль
 * @Description:
 * В данном проекте реализовано управление скоростью вращения вала двигателя
 * посредством частотно-импульсной модуляции. Модуляция организована
 * на таймере 1 (канал 2). Частота импульсов задаётся положением ручки
 * потенциометра через АЦП.
 ******************************************************************************/

// Подключение заголовка
#include "main.h"

// Основная функция
int main(void)
{
  // Общая инициализация
  CPU_Init();   // Система тактирования
  TICK_Init();  // Системный таймер
  LCD_Init();   // ЖК-дисплей

  // Инициализация АЦП
  ADC_Init();

  // Инициализация ШИМ
  PWM_Init();

  // Инициализация двигателя
  HSM_Init();

  // Расчётная частота
  uint32_t frequency = 0;

  // Основной цикл
  while (true) {

    // Блок работы с АЦП
    if ((Wait(&ticks_mark[0], 100) == false)) {

      // Медианная фильтрация выборки
      ADC_MedianFilter(adc_sample);

      // Создание зоны нечувствительности
      // для отключения двигателя (10%)
      if (adc_result[4] < D_MAX / 10) {
        frequency = 0;
      }

      // Вычисление частоты (в герцах)
      else {
        frequency = ADC_TO_FRQ(adc_result[4]);
      }

      // Задание частоты
      PWM_SetFrequency(frequency);

      // Отображение результатов
      LCD_PrintString("     F = %u Гц", 3, frequency);   // Частота
      LCD_PrintString("     D = %u", 5, adc_result[4]);  // Цифровое значение
    }
  }
}
