
#include "MDR32Fx.h"   
#include "stdint.h"
#include "string.h"
#include "stdio.h"

void uart2_send_char(unsigned char sign)
	{// отправка байта данных
	// ожидание готовности УАРТ2 для передачи байта данных
  while (MDR_UART2 -> FR & (1 << 5))
	{
	}
	
	MDR_UART2 -> DR = sign; // отправка байта
  }
	/*-------------------------------------------------------------*/
	void uart2_send_string(const char *tx_buffer)
	{
	while (MDR_UART2 -> FR & (1 << 5))
	{
	} 
  
	while(*tx_buffer)
	uart2_send_char(*tx_buffer ++);
	
	}
	
	/*----------------------------------------------------------------*/
	void uart2_send_byte(int byte)
	{// отправка байта данных
	// ожидание готовности УАРТ2 для передачи байта данных
  while (MDR_UART2 -> FR & (1 << 5))
	{
	}
	
	MDR_UART2 -> DR = byte; // отправка байта
  }
	/*-------------------------------------------------------------*/
//	void uart2_send_num(int tx_buffer[10])
//	{
//	while (MDR_UART2 -> FR & (1 << 5))
//	{
//	} 
//  
//	while(tx_buffer)
//	uart2_send_byte(tx_buffer[2]);
//	
//	}
	
/*------------------------------------------------------------------*/
 void uart2_init(void)
 { // инициализация модуля UART2
    // режим работы порта PD0, PD1 - UART2
  MDR_PORTD -> FUNC |= ((2 << 2) | (2 << 0));
  MDR_PORTD -> ANALOG |= ((1 << 1) | (1 << 0)); // цифровой порт
  MDR_PORTD -> PWR |= ((3 << 2) | (3 << 0)); // максимально быcтрый фронт
  MDR_RST_CLK -> PER_CLOCK |= (1 << 7); // вкл. тактирование UART2
  MDR_RST_CLK -> UART_CLOCK = (0 // установка делителя UART1 = 1
   | (0 << 8) // установка делителя UART2 = 1
   | (0 << 24) // запрет тактовой частоты UART1
   | (1 << 25)); // разрешение тактирования UART2
   // Параметры делителя при частоте = 8 МГц и скорости 115200
  MDR_UART2 -> IBRD = 4; // целая часть делителя скорости
  MDR_UART2 -> FBRD = 22; // дробная часть делителя скорости
  MDR_UART2 -> LCR_H = ( (0 << 1) // работа без проверки четности
   | (0 << 2) // бит четности отключен
   | (0 << 3) // кол-во стоповых бит = 1
   | (0 << 4) // буфер FIFO выключен
   | (3 << 5) // размер кадра – 8 бит
   | (0 << 7)); // передача бита четности запрещена
  // передатчик и приемник разрешен, разрешение приемопередатчика UART2
  MDR_UART2 -> CR = ( (1 << 8) | (1 << 9) | 1);
 }
 
 // Для настройки прерывания при получении байта данных необходимо:
 //1) Разрешить прерывание от приемника в регистре MDR_UART2->IMSC:
/*------------------------------------------------------------------*/
  void uart2_interrupt_init(void)
  {
   MDR_UART2->IMSC = 1 << 4; // разрешение прерывания от приемника UARTRXINTR
  }
/*------------------------------------------------------------------*/
/*------------------------------------------------------------------*/
// 3) Создать функцию-обработчик прерывания от UART2:
  /*------------------------------------------------------------------*/
  void UART2_IRQHandler(void)
  { /// прерывание возникает при поступлении 1 байта
   uint8_t rx_byte = MDR_UART2->DR; // считывание символа из буфера приемника
		
		if (rx_byte == '1') MDR_PORTA->RXTX = 0x01;                  
		if (rx_byte == '2') MDR_PORTA->RXTX = 0x02;
		if (rx_byte == '3') MDR_PORTA->RXTX = 0x04;
		if (rx_byte == '4') MDR_PORTA->RXTX = 0x08;
		if (rx_byte == '5') MDR_PORTA->RXTX = 0x10;
		if (rx_byte == '6') MDR_PORTA->RXTX = 0x20;
		if (rx_byte == '7') MDR_PORTA->RXTX = 0x40;
		if (rx_byte == '8') MDR_PORTA->RXTX = 0x80;
		
   MDR_UART2 -> ICR = 1 << 4; // сброс прерывания
  }/*------------------------------------------------------------------*/
	
	
 