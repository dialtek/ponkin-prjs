/*=========================================================================== */
// Milkites UART

void Uart2_init (void){
// инициализация модуля UART2
	  
MDR_PORTD->FUNC   |= ((2 << 2) | (2 << 0)); // режим работы порта - UART2
MDR_PORTD->ANALOG |= ((1 << 1) | (1 << 0)); // цифровой порт
MDR_PORTD->PWR    |= ((3 << 2) | (3 << 0)); // максимально быcтрый фронт

MDR_RST_CLK->PER_CLOCK |= (1 << 7);    // вкл. тактирование UART2
MDR_RST_CLK->UART_CLOCK = (0           // установка делителя для UART1 = 1
                          |(0 << 8)    // установка делителя для UART2 = 1
                          |(0 << 24)   // запрет тактовой частоты UART1
                          |(1 << 25)); // разрешение тактовой частоты UART2 

 //Параметры делителя при частоте = 80 Мгц и скорости = 115200
MDR_UART2->IBRD = 43;   // целая часть делителя скорости
MDR_UART2->FBRD = 26;   // дробная часть делителя скорости

MDR_UART2->LCR_H = ((0 << 1) // работа без провеки четности 
                   |(0 << 2) // бит четности отключен
                   |(0 << 3) // кол-во стоповых бит = 1
                   |(1 << 4) // включение буфера FIFO
                   |(3 << 5) // размер кадра - 8 бит
                   |(0 << 7)); // передача бита четности запрещена

// Прерывания  по  переполнению  буфера UARTOEINTR 
MDR_UART2->IMSC = (1 << 4) | (1 << 10); 
// Разрешение прерывание при залолнении 1/2 буфера FIFO (8 байт)
MDR_UART2->IFLS = 2 << 3;       

//передачик и приемник разрешен, разрешение приемопередатчика UART2
MDR_UART2->CR = ((1 << 8)|(1 << 9) | 1); 
}
	
void Uart_send_hex(uint8_t hex_data){	  
// пока Буфер FIFO передатчика заполнен...  
while(MDR_UART2->FR & (1<<5)) { }; // ждем готовности UART2;
MDR_UART2->DR = hex_data;
}
	  
void Uart_CR_LF_send (void){
  
   Uart_send_hex(0x0A);
   Uart_send_hex(0x0D);	
}

void Uart_send_num(int32_t data){
	  
  unsigned char buf[10], count=0;
  
  if (data < 0)                       // если отрицательное число 
  {
    data = -data;                     // инвертируем число
    Uart_send_hex('-');               // выводим знак
  }   
  
  if (data)                           // если положительное число 
  {
    while (data)
    {                                 // разложение числа на отдельные цифры
      buf[count++] = data % 10 + '0';
      data /= 10;                 
    }
    
    while (count)                     // вывод буфера отдельных чисел на дисплей
      Uart_send_hex(buf[--count]);          
  }
  else Uart_send_hex('0');            // NaN
}

void Uart_send_text(unsigned char *s){
  while (*s != 0)
    Uart_send_hex(*s++);
}
