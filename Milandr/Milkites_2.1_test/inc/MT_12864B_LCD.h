// v2.1 с изменениями для проекта АТ

#ifndef __MT_12864B_LCD__
#define __MT_12864B_LCD__

#define LCD_reset_ON	     MDR_PORTB->RXTX |=   (1<<10) 
#define LCD_reset_OFF 	     MDR_PORTB->RXTX &=  ~(1<<10) 
#define LCD_A0_ON 	     MDR_PORTE->RXTX |=   (1<<1)  
#define LCD_A0_OFF 	     MDR_PORTE->RXTX &=  ~(1<<1)
#define LCD_CS_ON 	     MDR_PORTF->RXTX |=   (1<<2)  
#define LCD_CS_OFF 	     MDR_PORTF->RXTX &=  ~(1<<2)


uint8_t INIT_LCD_TABLE [21] = {
0xAE, //(1)disp OFF
0xE2, //(14)reset
0x40, //(2)disp start adr
0xB0, //(3)page adr
0x10, //(4)high column adr
0x00, //(4)low column adr 
0xA0, //(8)нормально/зеркально лево-право
0xA3, //(11)voltage ratio при пониженном напр. сделать А3
0xA4, //(10)все пиксели вкл при A5
0xA6, //(9)negative - A7 pozitive - A6
0xC8, //(15)нормально/зеркально верх-низ
0x81, //(18) Electronic Volume (Double Byte Command)
0x25, //(18) насыщнность.
0x89, //(29)регулировка V0
0x01,
0x2F, //(16)включение внутренних преобразователей 
0x26, //(17)volt.reg V0
0xAD, // (19) Static Indicator (Double Byte Command)
0x02, // (19)
0xe3,
0xAF  // включить дисплей 
};

/*--------------------------------------------------------------------------- */
//ШРИФТ ПОЛНЫЙ 5х7
const uint8_t LCD_5x7_font[][5] = 
{
 //0x20 и далее (0x00-0x60)
 
 {0x3e,0x51,0x49,0x45,0x3e}, //0 
{0x00,0x42,0x7f,0x40,0x00}, //1 
{0x42,0x61,0x51,0x49,0x46}, //2 
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{0x20,0x10,0x20,0x20,0x10}, //~ 140 

};/**/

/*--------------------------------------------------------------------------- */
// -- LCD commands
    void LCD_wr_cmd (uint8_t cmd){
	  
        LCD_A0_OFF;
	SPI1_Wr_Data(cmd);
	LCD_A0_ON;
	}

    void LCD_init (void) {
	  
	LCD_reset_OFF;
	delay_us(20);
	LCD_reset_ON;
    LCD_A0_OFF;
	
	for(uint8_t i = 0; i<21;i++) {SPI1_Wr_Data(INIT_LCD_TABLE[i]); delay_us(3);}
	
	}

    void LCD_wr_data (uint8_t data) {
	  
	  LCD_A0_ON;
	  SPI1_Wr_Data(data);
	  LCD_A0_OFF;
	}

    void LCD_page_adr_set (uint8_t page) {
    LCD_A0_OFF;
	SPI1_Wr_Data(0xB0 | page);

  	}

    void LCD_column_adr_set (uint8_t column) {

  	uint8_t i = 0;
	LCD_A0_OFF;
	i = column & 0x0F;
	SPI1_Wr_Data(0x00+i);
	SPI1_Wr_Data(0x10+(column >> 4));

	}
    
    void LCD_inverse_ON (void) {
    // отменить инвертирование цвета дисплея
	LCD_A0_OFF;
	SPI1_Wr_Data(0xA7);

	}
  
    void LCD_inverse_OFF (void) {
    // инвертирование цвета дисплея
	  
	LCD_A0_OFF;
	SPI1_Wr_Data(0xA6);


	}
// ------------------------------------ 
    void LCD_set_cursor (uint8_t setPoint){
	  
	  LCD_page_adr_set(setPoint);
	  LCD_column_adr_set(0);
	 
   }
	
    void LCD_clear (void) {
  		
	for(uint8_t p=0; p<8; p++) {    //Цикл по всем 8-ми страницам индикатора
		LCD_page_adr_set(p);                 //Установка текущей страницы для левого кристалла индикатора
		LCD_column_adr_set(0);
		for(uint8_t c=0; c<130; c++) {   //Цикл вывода данных в левую половину индикатора
		  LCD_wr_data(0x00);     		 //Вывод очередного байта в индикатор
		  
		}
  
  }
  }

    void LCD_wr_char (char symbol){
      
      uint8_t char_code; 
      
switch (symbol) {
  
case '0': char_code = 0; break; 
case '1': char_code = 1; break; 
case '2': char_code = 2; break; 
case '3': char_code = 3; break; 
case '4': char_code = 4; break; 
case '5': char_code = 5; break; 
case '6': char_code = 6; break; 
case '7': char_code = 7; break; 
case '8': char_code = 8; break; 
case '9': char_code = 9; break; 
case 'А': char_code = 10; break; 
case 'а': char_code = 42; break; 
case 'Б': char_code = 11; break; 
case 'б': char_code = 43; break; 
case 'В': char_code = 12; break; 
case 'в': char_code = 44; break; 
case 'Г': char_code = 13; break; 
case 'г': char_code = 45; break; 
case 'Д': char_code = 14; break; 
case 'д': char_code = 46; break; 
case 'Е': char_code = 15; break; 
case 'е': char_code = 47; break; 
case 'Ё': char_code = 15; break; 
case 'ё': char_code = 47; break; 
case 'Ж': char_code = 16; break; 
case 'ж': char_code = 48; break; 
case 'З': char_code = 17; break; 
case 'з': char_code = 49; break; 
case 'И': char_code = 18; break; 
case 'и': char_code = 50; break; 
case 'Й': char_code = 19; break; 
case 'й': char_code = 51; break; 
case 'К': char_code = 20; break; 
case 'к': char_code = 52; break; 
case 'Л': char_code = 21; break; 
case 'л': char_code = 53; break; 
case 'М': char_code = 22; break; 
case 'м': char_code = 54; break; 
case 'Н': char_code = 23; break; 
case 'н': char_code = 55; break; 
case 'О': char_code = 24; break; 
case 'о': char_code = 56; break; 
case 'П': char_code = 25; break; 
case 'п': char_code = 57; break; 
case 'Р': char_code = 26; break; 
case 'р': char_code = 58; break; 
case 'С': char_code = 27; break; 
case 'с': char_code = 59; break; 
case 'Т': char_code = 28; break; 
case 'т': char_code = 60; break; 
case 'У': char_code = 29; break; 
case 'у': char_code = 61; break; 
case 'Ф': char_code = 30; break; 
case 'ф': char_code = 62; break; 
case 'Х': char_code = 31; break; 
case 'х': char_code = 63; break; 
case 'Ц': char_code = 32; break; 
case 'ц': char_code = 64; break; 
case 'Ч': char_code = 33; break; 
case 'ч': char_code = 65; break; 
case 'Ш': char_code = 34; break; 
case 'ш': char_code = 66; break; 
case 'Щ': char_code = 35; break; 
case 'щ': char_code = 67; break; 
case 'Ъ': char_code = 36; break; 
case 'ъ': char_code = 68; break; 
case 'Ы': char_code = 37; break; 
case 'ы': char_code = 69; break; 
case 'Ь': char_code = 38; break; 
case 'ь': char_code = 70; break; 
case 'Э': char_code = 39; break; 
case 'э': char_code = 71; break; 
case 'Ю': char_code = 40; break; 
case 'ю': char_code = 72; break; 
case 'Я': char_code = 41; break; 
case 'я': char_code = 73; break; 

case 'A': char_code = 10; break; 
case 'a': char_code = 42; break; 
case 'B': char_code = 12; break; 
case 'b': char_code = 89; break; 
case 'C': char_code = 27; break; 
case 'c': char_code = 59; break; 
case 'D': char_code = 74; break; 
case 'd': char_code = 90; break; 
case 'E': char_code = 15; break; 
case 'e': char_code = 47; break; 
case 'F': char_code = 75; break; 
case 'f': char_code = 91; break; 
case 'G': char_code = 76; break; 
case 'g': char_code = 92; break; 
case 'H': char_code = 23; break; 
case 'h': char_code = 93; break; 
case 'I': char_code = 77; break; 
case 'i': char_code = 94; break; 
case 'J': char_code = 78; break; 
case 'j': char_code = 95; break; 
case 'K': char_code = 20; break; 
case 'k': char_code = 96; break; 
case 'L': char_code = 79; break; 
case 'l': char_code = 97; break; 
case 'M': char_code = 22; break; 
case 'm': char_code = 98; break; 
case 'N': char_code = 80; break; 
case 'n': char_code = 99; break; 
case 'O': char_code = 24; break; 
case 'o': char_code = 56; break; 
case 'P': char_code = 26; break; 
case 'p': char_code = 58; break; 
case 'Q': char_code = 81; break; 
case 'q': char_code = 100; break; 
case 'R': char_code = 82; break; 
case 'r': char_code = 101; break;
case 'S': char_code = 83; break; 
case 's': char_code = 102; break; 
case 'T': char_code = 28; break; 
case 't': char_code = 103; break; 
case 'U': char_code = 84; break; 
case 'u': char_code = 104; break; 
case 'V': char_code = 85; break; 
case 'v': char_code = 105; break; 
case 'W': char_code = 86; break; 
case 'w': char_code = 106; break; 
case 'X': char_code = 31; break; 
case 'x': char_code = 63; break; 
case 'Y': char_code = 87; break; 
case 'y': char_code = 107; break; 
case 'Z': char_code = 88; break; 
case 'z': char_code = 108; break; 

case ' ': char_code = 109; break; 
case '+': char_code = 110; break; 
case '-': char_code = 111; break; 
case '=': char_code = 112; break; 
case ':': char_code = 113; break; 
case ',': char_code = 114; break; 
case '.': char_code = 115; break; 
case '?': char_code = 116; break; 
case '#': char_code = 117; break; 
case '!': char_code = 118; break; 
case '"': char_code = 119; break; 
case '$': char_code = 120; break; 
case '%': char_code = 121; break; 
case '&': char_code = 122; break; 
case '(': char_code = 123; break; 
case ')': char_code = 124; break; 
case '*': char_code = 125; break; 
case '/': char_code = 126; break; 
case ';': char_code = 127; break; 
case '<': char_code = 128; break; 
case '>': char_code = 129; break; 
case '@': char_code = 130; break; 
case '[': char_code = 131; break; 
//case '\': char_code = 132; break; 
case ']': char_code = 133; break; 
case '^': char_code = 134; break; 
case '_': char_code = 135; break; 
//case ''': char_code = 136; break; 
case '{': char_code = 137; break; 
case '|': char_code = 138; break; 
case '}': char_code = 139; break; 
case '~': char_code = 140; break; 
// case '°': char_code = ; break;
}

for (uint8_t i=0;i<5;i++)
{ // вывод построчно 	
  LCD_wr_data(LCD_5x7_font[char_code][i]);
}


   }

    void LCD_print_uni_logo (void) {
	// Вывод на дисплей Лого универа и кафедрф
	  	uint8_t logo [8][128] = { 

	0xFF, 0x01, 0xFD, 0xFD, 0xFD, 0xE1, 0xE1, 0xF1, 0x39, 0x1D, 0x0D, 0x05,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 0xFF, 
	0xFF, 0x00, 0x0F, 0x0F, 0x0F, 0x00, 0x01, 0x03, 0x07, 0x0E, 0x0C, 0x08,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 0xFF, 
	0xFF, 0x00, 0x00, 0x00, 0x00, 0xC0, 0xF0, 0x3C, 0x0E, 0x06, 0x1C, 0x78,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 0xFF, 
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	0xFF, 0x80, 0x80, 0x80, 0x80, 0x80, 0x8F, 0x8F, 0x80, 0x80, 0x87, 0x8F,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 0xFF, 
};
	  
  		for(uint8_t p=0; p<8; p++) {
  			LCD_page_adr_set(p);
  			LCD_column_adr_set(0);
			for(uint8_t i=0; i<128; i++) {
			  LCD_wr_data(logo[p][i]);
			}
		}
  }
// -------------------------------------	
    void LCD_wr_num (int32_t number) {
  
  unsigned char buf[10], count = 0;
 
  if (number < 0) // negative num
  {
    number = -number;
    LCD_wr_char('-');
    LCD_wr_data(0); // space 1px
  }     
  //--
  if (number)
  {
    while(number) // positive num
    { // разложение числа на отдельные цифры
      buf[count++]= number % 10 +'0';
      number /= 10;                 
    }                           
    while (count)
    { // вывод буфера отдельных чисел на дисплей
      LCD_wr_char(buf[--count]);
      LCD_wr_data(0); // space 1px
    }
  }
  //--
  else LCD_wr_char('0'); // NaN         
}
	
    void LCD_print (unsigned char* full_str){
      
    while (*full_str)
    {
      LCD_wr_char(*full_str++);
      LCD_wr_data(0); // space 1px
    }  
}
   
    void Milkites_welcome (void) {
	  
	  LCD_clear();
	  LCD_print_uni_logo();
	  delay_ms(4000);
	  LCD_clear();
	  LCD_set_cursor(0);
	  LCD_print("       МилКиТЭС");
	  LCD_set_cursor(1);
	  LCD_print("==================");
	  LCD_set_cursor(2);
	  LCD_print("      Отладочная   ");
	  LCD_set_cursor(4);
	  LCD_print("  плата МК Миландр ");	  
	  LCD_set_cursor(6);
	  LCD_print("      китэс Дубна ");
	  //LCD_set_cursor(7);
	 // LCD_print("      кафедра ПЭ");
	  delay_ms(5000);
	  
		}

#endif