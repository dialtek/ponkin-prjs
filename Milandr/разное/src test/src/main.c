#include "MDR32Fx.h"  

#define U8  uint8_t
#define U16 uint16_t 
#define U32 uint32_t

   void delay_20us (void){
     uint8_t i;
    for(i = 0; i < 22; i++){}  
  }
  
   void delay_3us (void){
     uint8_t i;
    for(i = 0; i < 4; i++){}  
  }
  
   void delay_5us (void){
     uint8_t i;
    for(i = 0; i < 7; i++){}  
  }
  
   void delay_100us (void){
    uint8_t i;
    for(i = 0; i < 156; i++){}  

  }
  
   void delay_1ms (void){
     uint32_t i;
    for(i = 0; i < 1610; i++){}  
  }
  
   void big_delay (void){
     uint32_t i;
    for(i = 0; i < 161000; i++){}  
  }



/* Установка и сброс бит в регистрах ввода-вывода с помощью макроса */
#define setBIT(ADDRESS,BIT)   (ADDRESS |= (1<<BIT))
#define clearBIT(ADDRESS,BIT) (ADDRESS &= ~(1<<BIT))

//---------------------------LCD defines--------------------------------------//
#define LCD_E1_ON   MDR_PORTE->RXTX |=  (1<<4) 
#define LCD_E1_OFF  MDR_PORTE->RXTX &= ~(1<<4)
#define LCD_E2_ON   MDR_PORTE->RXTX |=  (1<<5) 
#define LCD_E2_OFF  MDR_PORTE->RXTX &= ~(1<<5)
#define LCD_A0_ON   MDR_PORTE->RXTX |=  (1<<11) 
#define LCD_A0_OFF  MDR_PORTE->RXTX &= ~(1<<11) 
#define LCD_RES_ON  MDR_PORTE->RXTX |=  (1<<10) 
#define LCD_RES_OFF MDR_PORTE->RXTX &= ~(1<<10)
#define LCD_E_ON    MDR_PORTC->RXTX |=  (1<<7) 
#define LCD_E_OFF   MDR_PORTC->RXTX &= ~(1<<7)
#define LCD_RW_ON   MDR_PORTC->RXTX |=  (1<<2) 
#define LCD_RW_OFF  MDR_PORTC->RXTX &= ~(1<<2)
//-----------------------End of LCD defines------------------------------------//
#include "mt-12854B.h"
   void OSC_init(void){
//---CLK-----------------------------------------------------------------------------------------------------
  MDR_RST_CLK->PER_CLOCK = 0xFFFFFFFF;                    // вкл. тактирование всей перефирии
  MDR_RST_CLK->HS_CONTROL = 0x01;                         // вкл. HSE осцилятор
  while ((MDR_RST_CLK->CLOCK_STATUS & (1 << 2)) == 0x00); // ждем пока HSE выйдет в рабочий режим
  MDR_RST_CLK->PLL_CONTROL = ((1 << 2) | (0 << 8));       // вкл. PLL | коэф. умножения = 0 ? проверить
  while((MDR_RST_CLK->CLOCK_STATUS & 0x02) != 0x02);      // ждем когда PLL выйдет в раб. режим

  MDR_RST_CLK->CPU_CLOCK  = (2                            // источник для CPU_C1
						   |(1 << 2)                      // источник для CPU_C2
						   |(0 << 4)                      // предделитель для CPU_C3
						   |(1 << 8));                    // источник для HCLK
 
  // при Fosc = 10 Mгц и PLL = 10 -> "t_Nop" ~ 310 нс!  
  
  }
   
   void GPIO_init (void){
  MDR_PORTD->OE = 0xff;                 // порт D на выход
  MDR_PORTD->FUNC = 0x0000;             // функция - порт 
  MDR_PORTD->ANALOG  = 0xffff;          // режим потра - цифровой
  MDR_PORTD->PWR     = 0xFFFFFFFF;      // максимально быстрый фронт ( порядка 10 нс)
  
  MDR_PORTA->OE      = 0xff;            // порт A0-A7 на выход (LCD D0-D7)
  MDR_PORTA->FUNC    = 0x0000;          // функция - порт 
  MDR_PORTA->ANALOG  = 0xffff;          // режим потра - цифровой
  MDR_PORTA->PWR     = 0xFFFFFFFF;      // максимально быстрый фронт ( порядка 10 нс)
  //LCD-------------------------------------------------------------------------//
  MDR_PORTE->OE = 0xffff;               // порт E на выход
  MDR_PORTE->FUNC = 0x0000;             // функция - порт 
  MDR_PORTE->ANALOG  = 0xffff;          // режим потра - цифровой
  MDR_PORTE->PWR     = 0xFFFFFFFF;      // быстрый фронт ( порядка 10 нс)
 
  MDR_PORTC->OE      = (1<<2)|(1<<7);   // LCD_RW и LCD_E пины на выход
  MDR_PORTC->FUNC    = 0x0000;          // функция - порт 
  MDR_PORTC->ANALOG  = 0xffff;          // режим потра - цифровой
  MDR_PORTC->PWR     = 0xFFFFFFFF;      // максимально быстрый фронт ( порядка 10 нс)
  
  }


   int main()
{
   const uint8_t Logo128 [8][128]=//128x64 pixel, каждые 8 вертикальных точек собраны в байт
{
	{	0xFF,0x01,0x01,0x01,0x01,0x01,0x01,0x01,0x01,0x01,0x01,0x01,0x01,0x01,0x01,0x01,
		0x01,0x01,0x01,0x01,0x01,0x01,0x01,0x01,0x01,0x01,0x01,0x01,0x01,0x01,0x01,0x01,
		0x01,0x01,0x01,0x01,0x01,0x01,0x01,0x01,0x01,0x01,0x01,0x01,0x01,0x01,0x01,0x01,
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		0x01,0x01,0x01,0x01,0x01,0x01,0x01,0x01,0x01,0x01,0x01,0x01,0x01,0x01,0x01,0xFF
	},
	{	0xFF,0x00,0x00,0x00,0x00,0x00,0x00,0x00,0x80,0xC0,0xE0,0xC0,0xE0,0xF0,0xF0,0xF0,
		0xF0,0xF0,0xF0,0xF0,0xF0,0xF0,0xF0,0xF0,0xF0,0xF0,0xE0,0xE0,0xE0,0xC0,0x80,0x00,
		0x00,0x00,0x00,0x80,0x00,0x00,0x00,0x80,0x00,0x80,0x00,0x80,0x00,0x80,0x00,0x80,
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		0x80,0x00,0x80,0x00,0x80,0x00,0x80,0x00,0x80,0x00,0x80,0x00,0x80,0x00,0x80,0x3F
	},
	{	0x1F,0xC0,0xE0,0xE0,0xFC,0xFE,0xF3,0xE3,0xE3,0xE3,0xE3,0xAF,0x6F,0xFF,0xFF,0xFF,
		0xBF,0xBF,0xFF,0xFF,0x7F,0x7F,0xFF,0xFF,0xFF,0xFF,0xFF,0xFF,0xFF,0xFF,0xFF,0xFF,
		0xFF,0xF6,0xF4,0x1F,0x21,0xE2,0x61,0x6F,0x60,0x6F,0x64,0x6F,0x60,0x6F,0x65,0x68,
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		0x6D,0x60,0x6F,0x62,0x6F,0x60,0x6F,0x64,0x6F,0x60,0x6F,0x65,0x68,0x64,0x6A,0x6F
	},
	{	0xFE,0x3F,0x3F,0x3F,0xBF,0xFF,0xFF,0xFF,0xFF,0xFF,0xFF,0xFF,0xFE,0xF9,0x77,0x37,
		0x03,0x03,0x01,0x00,0x00,0x00,0x00,0x01,0x07,0x0F,0x13,0x01,0x00,0x00,0x01,0x07,
		0xD7,0x0E,0x08,0xC0,0x00,0x10,0x0F,0xF8,0x00,0x00,0x80,0xE0,0xF8,0xFE,0xFF,0xFF,
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		0x0F,0x0F,0xFF,0xFF,0xFF,0xFF,0xFF,0x0F,0x0F,0x0F,0x0F,0x0F,0x0F,0x0F,0x06,0xF0
	},
	{	0x3F,0xE0,0x00,0x00,0x01,0x3F,0xFF,0xFF,0xFF,0xFF,0xFF,0x3F,0x3F,0x00,0x00,0xE0,
		0x00,0x00,0x00,0x00,0x00,0x00,0x00,0x00,0x00,0x00,0x00,0x00,0x00,0x00,0x00,0x00,
		0x00,0x01,0x01,0xC1,0xE0,0xE0,0xF9,0xFF,0xFC,0xFF,0xFF,0x7F,0x1F,0xFF,0xFF,0xFF,
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		0x00,0x00,0xFF,0xFF,0xFF,0xFF,0xFF,0x00,0x00,0x00,0x00,0x00,0x00,0x00,0x00,0xFF
	},
	{	0xFC,0x01,0x03,0x04,0x18,0x20,0x40,0x81,0x87,0x07,0x07,0x00,0x00,0x00,0x00,0x00,
		0x00,0x00,0x00,0x00,0x00,0x00,0x00,0x00,0x00,0x00,0x00,0x00,0x00,0x00,0x00,0x80,
		0x80,0xE4,0xE7,0xFB,0xFF,0xFF,0x7F,0x3F,0x0F,0x03,0x01,0x00,0x00,0xFF,0xFF,0xFF,
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		0x00,0x00,0xFF,0xFF,0xFF,0xFF,0xFF,0x00,0x00,0x00,0x00,0x00,0x00,0x00,0x00,0xFF
	},
	{	0xFF,0x00,0x00,0x00,0x00,0x00,0x00,0x00,0x00,0x01,0x02,0x02,0x04,0x04,0x04,0x0C,
		0x0C,0x0C,0x0C,0x0C,0x0C,0x0C,0x0C,0x0C,0x0C,0x04,0x04,0x04,0x02,0x03,0x01,0x00,
		0x00,0x03,0x07,0x07,0x03,0x01,0x00,0x00,0x00,0x00,0x00,0x00,0x00,0x03,0x07,0x07,
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		0x00,0x00,0x03,0x07,0x07,0x07,0x03,0x00,0x00,0x00,0x00,0x00,0x00,0x00,0x00,0xFF
	},
	{	0xFF,0x80,0x80,0x80,0x80,0x80,0x80,0x80,0x80,0x80,0x80,0x80,0x80,0x80,0x80,0x80,
		0x80,0x80,0x80,0x80,0x80,0x80,0x80,0x80,0x80,0x80,0x80,0x80,0x80,0x80,0x80,0x80,
		0x80,0x80,0x80,0x80,0x80,0x80,0x80,0x80,0x80,0x80,0x80,0x80,0x80,0x80,0x80,0x80,
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		0x80,0x80,0x80,0x80,0x80,0x80,0x80,0x80,0x80,0x80,0x80,0x80,0x80,0x80,0x80,0xFF
	}
};
 
   const uint8_t Lisa [8][64] =
{
	// ################################################################
	// #                                                              #
	// #                                                              #
	// #                                                              #
	// #                                                              #
	// #         ##                                           #       #
	// #         ##                                          ##       #
	// #        ####         #            ########           ##       #
	// #        ####        ###           ###  ###           ###      #
	// #       ### ##       ###      ##          ##         ####      #
	// #       ### ##       ###     ###          ##         ####      #
	// #       ##  ##       ###     ###          ##         ## #      #
	// #      ###  ###      ###    ####          ##         ## ##     #
	// #      ###   ##      ###    ####          #          #  ##     #
	// #     ###    ##      ###   ## ##        ###         ##  ##     #
	// #     ###    ###      ##  ### ##      ######        ##   #     #
	// #    ####    ###      ##  ##  ##    ##########      ##   ##    #
	// #    ###      ##      ## ##   ##            ###     ##   ##    #
	// #    ###      ##      ## ##   ##             ##    ### ####    #
	// #   ####      ###     ####    ##             ##    ########    #
	// #   ###       ###     ####    ##             ##    ####   ##   #
	// #  ####        ##     ###     ##             ##    ##     ##   #
	// #  ####        ###    ###     ##             ##    ##      #   #
	// #    #         ###    ##      ##             ##   ###      #   #
	// #                             ##            ##    ##       ##  #
	// #                                       #####     ##       ##  #
	// #                                  #########       #        #  #
	// #                                    ####                   #  #
	// #                                                              #
	// #                                                              #
	// #                                                              #
	// #                  #     #   ##                                #
	// #                  ##    #   #                                 #
	// #                    ##  #  ######                             #
	// #                     ########## ## #                          #
	// #                    ##   #  ########  #                       #
	// #               #####  ######  ## ######                       #
	// #                ### ### #  #  #   ####                        #
	// #               ### ##  ##  #  #    # ####                     #
	// #              ###### ###   #  #    #  ####                    #
	// #              # # # #  #   #  ##   #   ###                    #
	// #              # ##  # #    #   ##  #    ###                   #
	// #              # ##  # #    #    #  #    ## #                  #
	// #              # #   # #    #    #        #  ##                #
	// #              # #     #                  ##  ##               #
	// #             ## #                         #   ##              #
	// #             # ##    #####      #####     ##   #              #
	// #            ## ##    #   ##    #    #      ###  #             #
	// #           ##  ##    # ## #    # ## #      # ##  #            #
	// #          ##  ###    ##  #     #####       #  #   #     ##    #
	// #        ##   ## ##    ####                 #   #   #####      #
	// #            ##  ##                         #   ##             #
	// #           ##    ##    ##           ##     ##   ##            #
	// #         ##      ##     ##         ##      ##    ##           #
	// #        ##       ###     ###########      ###     ###         #
	// #                  ###      ########       # #                 #
	// #                   ###                   ## #                 #
	// #                     ##                 ## ##                 #
	// #                     #################### ##                  #
	// #                      #####################                   #
	// #                      #  #  #       ###                       #
	// #                       # ## ##########                        #
	// #                        #############                         #
	// ################################################################
	0xFF, 0x01, 0x01, 0x01, 0x01, 0x01, 0x01, 0x01, 0x01, 0x81, 0xE1, 0xE1,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 0xFF, 
	0xFF, 0x00, 0x00, 0x00, 0x00, 0x00, 0xC0, 0xF0, 0xFE, 0x3F, 0x07, 0x01,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 0xFF, 
	0xFF, 0x00, 0x00, 0x60, 0x78, 0xFF, 0x7F, 0x0F, 0x01, 0x00, 0x00, 0x00,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 0xFF, 
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	0xFF, 0x80, 0x80, 0x80, 0x80, 0x80, 0x80, 0x80, 0x80, 0x80, 0x80, 0x80,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 0xFF, 
};

   OSC_init();
   GPIO_init();
   LCD_init();
   LCD_draw_ktes();
   big_delay();
   big_delay();
   big_delay();
   LCD_full_clear();
   
  // 0x4002_0000  MDR_RST_CLK  адрес Контроллера тактовой частоты
  // 0x4007_0000  timer 1      адрес регистров Таймера 1
  // 0x400A_8000  PORTA        адрес регистров PORTA
  // 0x400C_0000  PORTD        адрес регистров PORTD
  // макс. скорость MT-12864, MT-6464 - 100-130 тысяч байтов/сек (1 млн. точек/сек)
  
  /*
  MDR_TIMER1->CNTRL = 0x00000000;                         // Режим инициализации таймера
  MDR_TIMER1->CNT   = 0x00000000;                         // Начальное значение счетчика
  MDR_TIMER1->PSG   = 128;                         // Предделитель частоты
  MDR_TIMER1->ARR   = 0xff;                              // Основание счета
  MDR_TIMER1->IE    = 0x00000002;                         // Разрешение генерировать прерывание при CNT=ARR
  MDR_RST_CLK->TIM_CLOCK  = (0|(1 << 24));                // делитель частоты|разрешение тактирования Таймера 1
  //MDR_TIMER1->STATUS= 0x00000000;                         // сбрасываем флаги
  NVIC_EnableIRQ(Timer1_IRQn);                            // Разрешение прерывания для Таймера 1
   //MDR_TIMER1->CNTRL = 1; // включить таймер 1
  //__enable_irq(); // Enable Interrupts
  */
   
  /*
              	for(uint8_t p=0; p<8; p++) {//Цикл по всем 8-ми страницам индикатора
		LCD_set_RAM_pageL(p);//Установка текущей страницы для левого кристалла индикатора
		LCD_set_page_AdrL(p);//Установка текущего адреса для записи данных в 0 для левого кристалла индикатора
		for(uint8_t c=0; c<64; c++) {//Цикл вывода данных в левую половину индикатора
			LCD_Wr_DataL(Logo128[p][c]);//Вывод очередного байта в индикатор
		}
		LCD_set_RAM_pageR(p);//Установка текущей страницы для правого кристалла индикатора
		LCD_set_page_AdrR(p);//Установка текущего адреса для записи данных в 0 для правого кристалла индикатора
		for(uint8_t c=64; c<128; c++) {//Цикл вывода данных в правую половину индикатора
			LCD_Wr_DataR(Logo128[p][c]);//Вывод очередного байта в индикатор
		}
               }
*/
   uint16_t x=0;

  while(1){
 
                LCD_set_cursor(0);
                LCD_print("  Привет студент!");
                LCD_set_cursor(1);
                LCD_print("*********************");
                LCD_set_cursor(3);
                LCD_print(" dubna electronics"); 
                LCD_set_cursor(5);
                LCD_print(" Пишу по-русски!");
                LCD_set_cursor(6);
                LCD_print("   Считаю:"); LCD_Wr_num(x,3);
                LCD_set_cursor(7);
                LCD_print("*********************");
                x++;
                if (x == 999){x=0;}
                big_delay();
                big_delay();
   
                

  }   
}   

   
  /*
  if (!(MDR_PORTC->RXTX & (1 << 10))){
    for(x=0;x<5000;x++){}
    if (!(MDR_PORTC->RXTX & (1 << 10))){
     MDR_PORTD->RXTX = 0xffff;
     MDR_TIMER1->CNTRL = 1; // включить таймер 1
     for(x=0;x<5000000;x++){}
    
      }
     }
   */
  
  /*
 void Timer1_IRQHandler(void) //функция обработки прерывания irq
{

     MDR_PORTD->RXTX = 0xaaaa;
     for(x=0;x<2000000;x++){}     
     MDR_TIMER1->CNT = 0x00000000;      // установка знач. счетчика на 0
     MDR_TIMER1->STATUS &= ~(1 << 1);   // сброс статуса прерывания от таймера 1
     NVIC_ClearPendingIRQ(Timer1_IRQn); // сброс флага прерывания от таймера 1
 
}
*/
